## samples/bluetooth/hci_spi/sample.yaml
```yaml
sample:
  description: Allows Zephyr to provide Bluetooth connectivity via SPI.
  name: Bluetooth HCI SPI
tests:
  sample.bluetooth.hci_spi:
    harness: bluetooth
    platform_allow:
      - 96b_carbon/nrf51822
      - nrf51dk/nrf51822
    integration_platforms:
      - 96b_carbon/nrf51822
      - nrf51dk/nrf51822
    tags:
      - bluetooth
      - spi
  sample.bluetooth.hci_spi.mesh:
    harness: bluetooth
    extra_args: EXTRA_CONF_FILE="mesh.conf"
    platform_allow:
      - nrf52dk/nrf52832
    integration_platforms:
      - nrf52dk/nrf52832
    tags:
      - bluetooth
      - spi
      - mesh
```

## samples/bluetooth/mesh_demo/sample.yaml
```yaml
sample:
  name: Bluetooth Mesh Demo
tests:
  sample.bluetooth.mesh_demo:
    harness: bluetooth
    platform_allow: bbc_microbit nrf51_blenano qemu_x86 nrf52dk_nrf52832
    tags: bluetooth
```
